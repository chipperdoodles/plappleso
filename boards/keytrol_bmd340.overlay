/*
 * Copyright (c) 2022 The ZMK Contributors
 *
 * SPDX-License-Identifier: MIT
 */


/ {
    keytrol: connector {
        compatible = "keytrol";
        #gpio-cells = <2>;
        gpio-map-mask = <0xffffffff 0xffffffc0>;
        gpio-map-pass-thru = <0 0x3f>;
        gpio-map
            = <1  0 &gpio0 23 0>    /* 0.23 */
            , <2  0 &gpio0 26 0>    /* 0.26 */
            , <3  0 &gpio0 27 0>    /* 0.27 */
            , <4  0 &gpio0 28 0>    /* 0.28 */
            , <5  0 &gpio0 29 0>    /* 0.29 */
            , <6  0 &gpio0 30 0>    /* 0.30 */
            , <7  0 &gpio0 31 0>    /* 0.31 */
            , <8  0 &gpio0 2  0>    /* 0.02 */
            , <9  0 &gpio1 12 0>    /* 1.12 */
            , <10 0 &gpio1 13 0>    /* 1.13 */
            , <11 0 &gpio0 3  0>    /* 0.03 */
            , <12 0 &gpio1 14 0>    /* 1.14 */
            , <13 0 &gpio0 5  0>    /* 0.05 */
            , <14 0 &gpio1 15 0>    /* 1.15 */
            , <15 0 &gpio0 7  0>    /* 0.07 */
            , <16 0 &gpio0 9  0>    /* 0.09 */
            , <17 0 &gpio0 11 0>    /* 0.11 */
            , <18 0 &gpio0 13 0>    /* 0.13 */
            , <19 0 &gpio0 14 0>    /* 0.14 */
            , <20 0 &gpio0 15 0>    /* 0.15 */
            , <21 0 &gpio0 16 0>    /* 0.16 */
            , <22 0 &gpio0 17 0>    /* 0.17 */
            , <23 0 &gpio0 21 0>    /* 0.21 */
            , <24 0 &gpio1 5  0>    /* 1.05 (cs) */
            , <25 0 &gpio1 8  0>    /* 1.08 (EXT_POWER) */
            , <26 0 &gpio1 9  0>    /* 1.09 (led) */
            ;
    };
};

keytrol_spi: &spi0{};