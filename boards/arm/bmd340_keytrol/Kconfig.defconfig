## boards/arm/bmd340_keytrol/Kconfig.defconfig
```kconfig
# Copyright (c) 2020 The ZMK Contributors
# SPDX-License-Identifier: MIT

if BOARD_BMD340_KEYTROL

config BOARD
    default "bmd340_keytrol"

if USB_DEVICE_STACK

config USB_NRFX
    default y

endif # USB_DEVICE_STACK

config BT_CTLR
    default BT

endif # BOARD_BMD340_KEYTROL
```

## boards/arm/keytrol_bmd340/Kconfig.board
```kconfig
# Copyright (c) 2020 The ZMK Contributors
# SPDX-License-Identifier: MIT

config BOARD_KEYTROL_BMD340
    bool "keytrol_bmd340"
    depends on SOC_NRF52840_QIAA
```

## boards/arm/keytrol_bmd340/Kconfig.defconfig
```kconfig
# Copyright (c) 2020 The ZMK Contributors
# SPDX-License-Identifier: MIT

if BOARD_KEYTROL_BMD340

config BOARD
    default "keytrol_bmd340"

if USB_DEVICE_STACK

config USB_NRFX
    default y

endif # USB_DEVICE_STACK

config BT_CTLR
    default BT

endif # BOARD_KEYTROL_BMD340
```

## boards/shields/plappleso/Kconfig.defconfig
```kconfig
if SHIELD_PLAPPLESO

config ZMK_KEYBOARD_NAME
    default "plappleso"

config ZMK_PM_SOFT_OFF
    default n

endif
```
